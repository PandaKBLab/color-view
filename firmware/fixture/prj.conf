## CMakeLists.txt
```
cmake_minimum_required(VERSION 3.20.0)
find_package(Zephyr REQUIRED HINTS $ENV{ZEPHYR_BASE})
project(color_view_fixture)
target_sources(app PRIVATE src/main.c)
```

## Kconfig
```
mainmenu "Color View fixture"

# The shared nice!nano v2 board defaults reference these ZMK options.
# In this standalone application they have no dependencies or side effects.
config ZMK_BLE
    bool "ZMK Bluetooth configuration compatibility"

config ZMK_USB
    bool "ZMK USB configuration compatibility"

source "Kconfig.zephyr"
```

## west.yml
```
manifest:
  projects:
    - name: zmk
      url: https://github.com/zmkfirmware/zmk
      revision: edf5c0814fd3ea202e43aad2d68fd32e882a518c
    - name: zephyr
      url: https://github.com/zmkfirmware/zephyr
      revision: dacab4875df72109b96cc8977547a0dc04875bcd
      import:
        name-allowlist: [cmsis, hal_nordic]
  self:
    path: fixture
```

## prj.conf
```kconfig
CONFIG_GPIO=y
CONFIG_NVS=n
CONFIG_SERIAL=n
CONFIG_CONSOLE=n
CONFIG_USB_DEVICE_STACK=n
CONFIG_BT=n
CONFIG_USE_DT_CODE_PARTITION=y
CONFIG_BUILD_OUTPUT_UF2=y
```

## src/main.c
```c
#include <stdbool.h>
#include <stdint.h>

#include <zephyr/device.h>
#include <zephyr/devicetree.h>
#include <zephyr/drivers/gpio.h>
#include <zephyr/kernel.h>
#include <zephyr/sys/util.h>

#include "text_frames.h"

enum {
    PIN_CS = 8,
    PIN_POWER = 13,
    PIN_LED = 15,
    PIN_MOSI = 17,
    PIN_SCK = 20,
    SIDE = 128,
    ROW_BYTES = SIDE * 3 / 8,
    ROWS_PER_TRANSFER = 16,
    COM_INTERVAL_MS = 500,
    POWER_SETTLE_MS = 20,
    DISCHARGE_MS = 1000,
    SWAP_MS = 5000,
    FRAME_MS = 1000,
    HOLD_MS = 2000,
};

enum pattern {
    BLACK = 0, RED = 1, GREEN = 2, YELLOW = 3,
    BLUE = 4, MAGENTA = 5, CYAN = 6, WHITE = 7,
    HORIZONTAL = 8, VERTICAL, CHECKER, INVERTED, MARKERS, MARKERS_MOVED,
    READY, EIGHT_COLORS, FINISHED,
};

struct test_frame {
    enum pattern pattern;
    uint16_t duration_ms;
};

static const struct device *const port = DEVICE_DT_GET(DT_NODELABEL(gpio0));
static const struct test_frame frames[] = {
    {READY, HOLD_MS},
    {BLACK, FRAME_MS}, {WHITE, FRAME_MS}, {RED, FRAME_MS}, {GREEN, FRAME_MS},
    {BLUE, FRAME_MS}, {CYAN, FRAME_MS}, {MAGENTA, FRAME_MS}, {YELLOW, FRAME_MS},
    {EIGHT_COLORS, HOLD_MS},
    {HORIZONTAL, FRAME_MS}, {VERTICAL, FRAME_MS},
    {CHECKER, FRAME_MS}, {INVERTED, FRAME_MS},
    {MARKERS, FRAME_MS}, {MARKERS_MOVED, FRAME_MS},
    {FINISHED, HOLD_MS},
};
static const enum pattern color_grid[2][4] = {
    {BLACK, WHITE, RED, GREEN},
    {BLUE, CYAN, MAGENTA, YELLOW},
};
BUILD_ASSERT(SIDE == (int)FIXTURE_TEXT_SIDE);

static bool com_high;
static int64_t next_com;

static void write_byte(uint8_t byte)
{
    for (unsigned bit = 0; bit < 8; ++bit) {
        gpio_pin_set_raw(port, PIN_MOSI, (byte >> bit) & 1u);
        k_busy_wait(1);
        gpio_pin_set_raw(port, PIN_SCK, 1);
        k_busy_wait(1);
        gpio_pin_set_raw(port, PIN_SCK, 0);
    }
}

static void select_panel(void)
{
    gpio_pin_set_raw(port, PIN_CS, 1);
    k_busy_wait(3);
}

static void deselect_panel(void)
{
    k_busy_wait(1);
    gpio_pin_set_raw(port, PIN_CS, 0);
    gpio_pin_set_raw(port, PIN_MOSI, 0);
    k_busy_wait(2);
}

static void send_command(uint8_t command)
{
    select_panel();
    write_byte(command | (com_high ? 2u : 0u));
    write_byte(0);
    deselect_panel();
}

static void service_com(void)
{
    if (k_uptime_get() >= next_com) {
        com_high = !com_high;
        send_command(0);
        next_com = k_uptime_get() + COM_INTERVAL_MS;
    }
}

static uint8_t pixel(enum pattern pattern, unsigned x, unsigned y)
{
    switch (pattern) {
    case READY:
    case FINISHED: {
        const uint8_t (*mask)[FIXTURE_TEXT_ROW_BYTES] =
            pattern == READY ? ready_text : finished_text;
        return (mask[y][x / 8] & BIT(7 - x % 8)) ? BLACK : WHITE;
    }
    case EIGHT_COLORS:
        return color_grid[y / (SIDE / 2)][x / (SIDE / 4)];
    case HORIZONTAL:
        return y % 2 ? WHITE : BLACK;
    case VERTICAL:
        return x % 2 ? WHITE : BLACK;
    case CHECKER:
    case INVERTED:
        return ((x ^ y ^ (pattern == INVERTED)) & 1u) ? WHITE : BLACK;
    case MARKERS:
    case MARKERS_MOVED: {
        if (x < 2 || y < 2 || x >= SIDE - 2 || y >= SIDE - 2) {
            return BLACK;
        }
        if (x < 15 && y < 15) { return RED; }
        if (x >= 113 && y < 15) { return GREEN; }
        if (x < 15 && y >= 113) { return BLUE; }
        if (x >= 113 && y >= 113) { return YELLOW; }
        if ((y >= 43 && y < 77 && x >= 63 && x <= 65) ||
            (y >= 43 && y <= 61 && (x == 64 - (y - 43) || x == 64 + (y - 43)))) {
            return BLACK;
        }
        const unsigned marker_x = pattern == MARKERS ? 22 : 94;
        return x >= marker_x && x < marker_x + 12 && y >= 90 && y < 102
            ? BLUE : WHITE;
    }
    default:
        return (uint8_t)pattern;
    }
}

static void send_frame(enum pattern pattern)
{
    for (unsigned first = 0; first < SIDE; first += ROWS_PER_TRANSFER) {
        service_com();
        select_panel();
        write_byte(1u | (com_high ? 2u : 0u));
        for (unsigned y = first; y < first + ROWS_PER_TRANSFER; ++y) {
            uint8_t row[ROW_BYTES] = {0};
            for (unsigned x = 0; x < SIDE; ++x) {
                const uint8_t color = pixel(pattern, x, y);
                for (unsigned channel = 0; channel < 3; ++channel) {
                    unsigned bit = x * 3 + channel;
                    row[bit / 8] |= ((color >> channel) & 1u) << (bit % 8);
                }
            }
            write_byte(y + 1);
            for (unsigned i = 0; i < ROW_BYTES; ++i) {
                write_byte(row[i]);
            }
            write_byte(0);
        }
        write_byte(0);
        deselect_panel();
    }
}

static void wait_with_com(int64_t deadline)
{
    for (;;) {
        service_com();
        int64_t now = k_uptime_get();
        if (now >= deadline) {
            return;
        }
        k_msleep((int32_t)MAX(1, MIN(deadline, next_com) - now));
    }
}

static void power_off(void)
{
    gpio_pin_set_raw(port, PIN_LED, 0);
    gpio_pin_set_raw(port, PIN_CS, 0);
    gpio_pin_set_raw(port, PIN_MOSI, 0);
    gpio_pin_set_raw(port, PIN_SCK, 0);
    gpio_pin_set_raw(port, PIN_POWER, 0);
}

int main(void)
{
    if (!device_is_ready(port)) {
        return 1;
    }
    const unsigned outputs[] = {PIN_POWER, PIN_CS, PIN_SCK, PIN_MOSI, PIN_LED};
    for (unsigned i = 0; i < ARRAY_SIZE(outputs); ++i) {
        if (gpio_pin_configure(port, outputs[i], GPIO_OUTPUT_LOW)) {
            return 1;
        }
    }

    for (;;) {
        power_off();
        k_msleep(DISCHARGE_MS);
        for (unsigned elapsed = 0; elapsed < SWAP_MS; elapsed += 1000) {
            gpio_pin_set_raw(port, PIN_LED, 1);
            k_msleep(500);
            gpio_pin_set_raw(port, PIN_LED, 0);
            k_msleep(500);
        }

        gpio_pin_set_raw(port, PIN_LED, 1);
        gpio_pin_set_raw(port, PIN_POWER, 1);
        k_msleep(POWER_SETTLE_MS);
        com_high = false;
        send_command(4);
        next_com = k_uptime_get() + COM_INTERVAL_MS;

        int64_t deadline = k_uptime_get();
        for (unsigned i = 0; i < ARRAY_SIZE(frames); ++i) {
            send_frame(frames[i].pattern);
            deadline += frames[i].duration_ms;
            wait_with_com(deadline);
        }
        send_command(4);
        k_busy_wait(30);
    }
}
```

## src/text_frames.h
```c
#pragma once

#include <stdint.h>

enum { FIXTURE_TEXT_SIDE = 128, FIXTURE_TEXT_ROW_BYTES = FIXTURE_TEXT_SIDE / 8 };

/* Approved bidirectional title frames. Each set bit is a black pixel, MSB first. */
static const uint8_t ready_text[FIXTURE_TEXT_SIDE][FIXTURE_TEXT_ROW_BYTES] = {
    [ 25] = {0x00, 0x00, 0x00, 0x00, 0x00, 0x0f, 0x80, 0x00, 0x00, 0x00, 0x00, 0x00, 0x00, 0x00, 0x00, 0x00},
    [ 26] = {0x00, 0x00, 0x06, 0x08, 0x00, 0x0f, 0x00, 0x00, 0x10, 0x00, 0x01, 0xc2, 0x00, 0x0f, 0x60, 0x00},
    [ 27] = {0x00, 0x00, 0x0f, 0x3c, 0x00, 0x1f, 0xff, 0xf8, 0x79, 0xff, 0x81, 0xcf, 0x00, 0x0f, 0xe0, 0x00},
    [ 28] = {0x00, 0x08, 0x0f, 0x3e, 0x00, 0x3f, 0xff, 0xf8, 0x3f, 0xff, 0x99, 0xc7, 0x80, 0x0f, 0xf0, 0x00},
    [ 29] = {0x00, 0x1c, 0x0e, 0x1f, 0x00, 0x7f, 0xff, 0xf8, 0x1f, 0xff, 0x99, 0xc7, 0x80, 0x0f, 0x78, 0x00},
    [ 30] = {0x00, 0x1e, 0x1e, 0x0e, 0x00, 0xfe, 0x01, 0xf0, 0x1d, 0xc1, 0x99, 0xc3, 0xc0, 0x0f, 0x30, 0x00},
    [ 31] = {0x00, 0x1f, 0x1f, 0xff, 0xf1, 0xff, 0x87, 0xe0, 0x09, 0xc1, 0x99, 0xc1, 0x9f, 0xff, 0xf8, 0x00},
    [ 32] = {0x00, 0x0f, 0x3f, 0xff, 0xf3, 0xc7, 0xff, 0x80, 0x01, 0xd9, 0x99, 0xc0, 0x1f, 0xff, 0xf8, 0x00},
    [ 33] = {0x00, 0x0f, 0xbf, 0xff, 0xf1, 0x03, 0xfe, 0x00, 0x21, 0xd9, 0x99, 0xc0, 0x1f, 0xff, 0xf8, 0x00},
    [ 34] = {0x00, 0x07, 0x7e, 0x1e, 0x00, 0x1f, 0xff, 0xfe, 0x79, 0xd9, 0x99, 0xdf, 0x80, 0x0f, 0x00, 0x00},
    [ 35] = {0x00, 0x02, 0x7e, 0x1e, 0x00, 0xff, 0xff, 0xfe, 0x7d, 0xd9, 0x99, 0xdf, 0x80, 0x0f, 0x00, 0x00},
    [ 36] = {0x00, 0x00, 0xff, 0xff, 0xf3, 0xf8, 0x00, 0xfc, 0x3f, 0xd9, 0x99, 0xdf, 0x80, 0x0f, 0x00, 0x00},
    [ 37] = {0x00, 0x00, 0xff, 0xff, 0xf3, 0xff, 0xff, 0xf8, 0x1d, 0xd9, 0x99, 0xc3, 0x9f, 0xff, 0x00, 0x00},
    [ 38] = {0x00, 0x00, 0x7f, 0xff, 0xf0, 0xff, 0xff, 0xf8, 0x09, 0xd9, 0x99, 0xc3, 0x9f, 0xf7, 0x00, 0x00},
    [ 39] = {0x00, 0x02, 0x5e, 0x1e, 0x00, 0xf0, 0x70, 0x78, 0x01, 0xd9, 0x99, 0xc3, 0x9f, 0xf7, 0x00, 0x00},
    [ 40] = {0x00, 0x07, 0x9e, 0x1e, 0x00, 0xf0, 0x70, 0x78, 0x19, 0xd9, 0x99, 0xc3, 0x83, 0x87, 0x00, 0x00},
    [ 41] = {0x00, 0x07, 0x9f, 0xff, 0xf0, 0xf0, 0x70, 0x78, 0x1f, 0xd9, 0x99, 0xc3, 0x83, 0x87, 0x00, 0x00},
    [ 42] = {0x00, 0x07, 0x9f, 0xff, 0xf0, 0xff, 0xff, 0xf8, 0x1d, 0xd9, 0x99, 0xc3, 0x83, 0x87, 0x00, 0x00},
    [ 43] = {0x00, 0x0f, 0x1f, 0xff, 0xf0, 0xff, 0xff, 0xf8, 0x1d, 0xf9, 0x99, 0xc3, 0x83, 0x87, 0x80, 0x00},
    [ 44] = {0x00, 0x0f, 0x1e, 0x1e, 0x00, 0xf0, 0x70, 0x78, 0x3c, 0x3a, 0x19, 0xc3, 0x93, 0x87, 0x90, 0x00},
    [ 45] = {0x00, 0x0e, 0x1e, 0x1e, 0x00, 0xf0, 0x70, 0x78, 0x3c, 0x7f, 0x19, 0xc3, 0xb3, 0x87, 0x9c, 0x00},
    [ 46] = {0x00, 0x1e, 0x1e, 0x1e, 0x00, 0xf0, 0x70, 0x78, 0x3c, 0x7f, 0x19, 0xc3, 0xf3, 0xf7, 0xbc, 0x00},
    [ 47] = {0x00, 0x1e, 0x1f, 0xff, 0xf0, 0xff, 0xff, 0xf8, 0x38, 0xf7, 0x81, 0xc3, 0xf3, 0xf3, 0xb8, 0x00},
    [ 48] = {0x00, 0x3c, 0x1f, 0xff, 0xf0, 0xff, 0xff, 0xf8, 0x39, 0xe3, 0xc3, 0xc3, 0xff, 0xf3, 0xb8, 0x00},
    [ 49] = {0x00, 0x1c, 0x1f, 0xff, 0xf0, 0xf0, 0x00, 0x78, 0x7b, 0xc1, 0xdf, 0xc7, 0xff, 0xe3, 0xf8, 0x00},
    [ 50] = {0x00, 0x04, 0x1e, 0x00, 0x00, 0x00, 0x00, 0x00, 0x79, 0xc1, 0x1f, 0x87, 0x9c, 0x01, 0xf0, 0x00},
    [ 51] = {0x00, 0x00, 0x1e, 0x00, 0x00, 0x00, 0x00, 0x00, 0x10, 0x80, 0x1f, 0x03, 0x00, 0x00, 0xe0, 0x00},
    [ 63] = {0x00, 0x00, 0x00, 0x00, 0x00, 0x00, 0x01, 0xff, 0xff, 0x80, 0x00, 0x00, 0x00, 0x00, 0x00, 0x00},
    [ 64] = {0x00, 0x00, 0x00, 0x00, 0x00, 0x00, 0x01, 0xff, 0xff, 0x80, 0x00, 0x00, 0x00, 0x00, 0x00, 0x00},
    [ 76] = {0x00, 0x07, 0x00, 0x00, 0xc0, 0xf8, 0x01, 0x08, 0x00, 0x00, 0x00, 0x00, 0x00, 0x78, 0x00, 0x00},
    [ 77] = {0x00, 0x0f, 0x80, 0x39, 0xe1, 0xf8, 0x83, 0x9e, 0x00, 0x00, 0x00, 0x00, 0x00, 0x78, 0x20, 0x00},
    [ 78] = {0x00, 0x1f, 0xc7, 0xff, 0xe3, 0xfb, 0x83, 0xde, 0x1e, 0x00, 0x0f, 0x0f, 0xff, 0xf8, 0x38, 0x00},
    [ 79] = {0x00, 0x1d, 0xcf, 0xff, 0xc3, 0xc3, 0xc7, 0x9c, 0x1f, 0xff, 0xff, 0x0f, 0xff, 0xf8, 0x3c, 0x00},
    [ 80] = {0x00, 0x1d, 0xcf, 0xcf, 0xc3, 0x81, 0xef, 0x1c, 0x1f, 0xff, 0xff, 0x0f, 0xff, 0xf8, 0x78, 0x00},
    [ 81] = {0x00, 0x3d, 0xef, 0xcf, 0xc3, 0x98, 0xfe, 0x3c, 0x1e, 0x0e, 0x0f, 0x00, 0x78, 0x78, 0x78, 0x00},
    [ 82] = {0x00, 0x39, 0xe1, 0xcd, 0xc3, 0x98, 0xfe, 0x3c, 0x1e, 0x0e, 0x0f, 0x00, 0x78, 0x78, 0x70, 0x00},
    [ 83] = {0x00, 0x09, 0xe1, 0xc9, 0xc3, 0x98, 0x5c, 0x3c, 0x1e, 0x0e, 0x0f, 0x00, 0x78, 0x78, 0xf0, 0x00},
    [ 84] = {0x00, 0x01, 0xe1, 0xc1, 0xc3, 0x99, 0x9f, 0xb8, 0x1f, 0xff, 0xff, 0x0f, 0xff, 0xf8, 0xf0, 0x00},
    [ 85] = {0x00, 0x00, 0xe1, 0xc1, 0xc3, 0x99, 0x9b, 0xb8, 0x1f, 0xff, 0xff, 0x0f, 0xff, 0xf9, 0xe0, 0x00},
    [ 86] = {0x00, 0x00, 0xe1, 0xc1, 0xc3, 0x99, 0x9b, 0xf8, 0x1e, 0x0e, 0x0f, 0x0f, 0xff, 0xf9, 0xe0, 0x00},
    [ 87] = {0x00, 0x00, 0xe1, 0xc1, 0xc3, 0x99, 0x9b, 0x98, 0x1e, 0x0e, 0x0f, 0x00, 0x78, 0x79, 0xe0, 0x00},
    [ 88] = {0x00, 0x00, 0xef, 0xf9, 0xc3, 0x99, 0x9b, 0x80, 0x1e, 0x0e, 0x0f, 0x00, 0x78, 0x7a, 0x40, 0x00},
    [ 89] = {0x00, 0x00, 0xef, 0xf9, 0xc3, 0x99, 0x9b, 0x90, 0x1f, 0xff, 0xff, 0x0f, 0xff, 0xfe, 0x00, 0x00},
    [ 90] = {0x00, 0x00, 0xff, 0xf9, 0xc3, 0x99, 0x9b, 0xb8, 0x1f, 0xff, 0xff, 0xcf, 0xff, 0xff, 0x00, 0x00},
    [ 91] = {0x00, 0x00, 0xf0, 0x01, 0xfb, 0x99, 0x9b, 0xfc, 0x3f, 0x00, 0x1f, 0xcf, 0xff, 0xff, 0x00, 0x00},
    [ 92] = {0x00, 0x00, 0xf0, 0x01, 0xfb, 0x99, 0x9b, 0xbe, 0x7f, 0xff, 0xff, 0x00, 0x78, 0x7e, 0x40, 0x00},
    [ 93] = {0x00, 0x00, 0xf0, 0x01, 0xfb, 0x99, 0x9b, 0x9e, 0x7f, 0xff, 0xf8, 0x00, 0x78, 0x7e, 0xe0, 0x00},
    [ 94] = {0x00, 0x1f, 0xff, 0xf8, 0x03, 0x99, 0x9b, 0x84, 0x00, 0x7f, 0xc0, 0x8f, 0xff, 0xfd, 0xf0, 0x00},
    [ 95] = {0x00, 0x1f, 0xff, 0xf8, 0x03, 0x99, 0x9b, 0x80, 0x01, 0xff, 0xe3, 0xcf, 0xff, 0xfc, 0xf0, 0x00},
    [ 96] = {0x00, 0x1f, 0xff, 0xf9, 0x83, 0x99, 0x83, 0x90, 0x07, 0xe1, 0xff, 0x8f, 0xff, 0xf8, 0xf8, 0x00},
    [ 97] = {0x00, 0x0c, 0xf0, 0x03, 0xc3, 0x99, 0x83, 0xb8, 0x0f, 0x80, 0x7f, 0x00, 0x70, 0x78, 0x78, 0x00},
    [ 98] = {0x00, 0x1e, 0xf0, 0x01, 0xe3, 0x99, 0xff, 0xf8, 0x1f, 0xff, 0xfe, 0x00, 0xf8, 0x70, 0x38, 0x00},
    [ 99] = {0x00, 0x0f, 0xf0, 0x01, 0xe3, 0x99, 0xff, 0xfc, 0x1f, 0xff, 0xfc, 0x00, 0x7c, 0xf0, 0x10, 0x00},
    [100] = {0x00, 0x07, 0xf0, 0x00, 0xf3, 0x81, 0xff, 0x9e, 0x1f, 0xff, 0xf8, 0x00, 0x3c, 0xf0, 0x00, 0x00},
    [101] = {0x00, 0x06, 0xf0, 0x00, 0x43, 0x80, 0x00, 0x08, 0x00, 0x00, 0xf0, 0x00, 0x10, 0x60, 0x00, 0x00},
    [102] = {0x00, 0x00, 0x00, 0x00, 0x00, 0x00, 0x00, 0x00, 0x00, 0x01, 0xf0, 0x00, 0x00, 0x00, 0x00, 0x00},
};

static const uint8_t finished_text[FIXTURE_TEXT_SIDE][FIXTURE_TEXT_ROW_BYTES] = {
    [ 26] = {0x00, 0x04, 0x00, 0x00, 0x70, 0x80, 0x03, 0xd8, 0x04, 0x00, 0xf0, 0x00, 0x01, 0xc0, 0x00, 0x00},
    [ 27] = {0x00, 0x1e, 0x7f, 0xe0, 0x73, 0xc0, 0x03, 0xf8, 0x0f, 0x00, 0xf0, 0x00, 0x01, 0xc0, 0x00, 0x00},
    [ 28] = {0x00, 0x0f, 0xff, 0xe6, 0x71, 0xe0, 0x03, 0xfc, 0x0f, 0x00, 0xf0, 0x00, 0x01, 0xc0, 0x00, 0x00},
    [ 29] = {0x00, 0x07, 0xff, 0xe6, 0x71, 0xe0, 0x03, 0xde, 0x1e, 0x3f, 0xff, 0xef, 0xff, 0xff, 0xf8, 0x00},
    [ 30] = {0x00, 0x07, 0x70, 0x66, 0x70, 0xf0, 0x03, 0xcc, 0x1c, 0x3f, 0xff, 0xef, 0xff, 0xff, 0xf8, 0x00},
    [ 31] = {0x00, 0x02, 0x70, 0x66, 0x70, 0x67, 0xff, 0xfe, 0x3c, 0xbf, 0xff, 0xef, 0xff, 0xff, 0xf8, 0x00},
    [ 32] = {0x00, 0x00, 0x76, 0x66, 0x70, 0x07, 0xff, 0xfe, 0x79, 0xe0, 0xf0, 0x00, 0x01, 0xc0, 0x00, 0x00},
    [ 33] = {0x00, 0x08, 0x76, 0x66, 0x70, 0x07, 0xff, 0xfe, 0x71, 0xe0, 0xf0, 0x00, 0x01, 0xc0, 0x00, 0x00},
    [ 34] = {0x00, 0x1e, 0x76, 0x66, 0x77, 0xe0, 0x03, 0xc0, 0xff, 0xc0, 0xf0, 0x03, 0xff, 0xff, 0xe0, 0x00},
    [ 35] = {0x00, 0x1f, 0x76, 0x66, 0x77, 0xe0, 0x03, 0xc0, 0x7f, 0x9f, 0xff, 0xc3, 0xff, 0xff, 0xe0, 0x00},
    [ 36] = {0x00, 0x0f, 0xf6, 0x66, 0x77, 0xe0, 0x03, 0xc0, 0x7f, 0x9f, 0xff, 0xc3, 0xff, 0xff, 0xe0, 0x00},
    [ 37] = {0x00, 0x07, 0x76, 0x66, 0x70, 0xe7, 0xff, 0xc0, 0x0f, 0x1f, 0xff, 0xc3, 0x81, 0xc0, 0xe0, 0x00},
    [ 38] = {0x00, 0x02, 0x76, 0x66, 0x70, 0xe7, 0xfd, 0xc0, 0x0f, 0x00, 0x00, 0x03, 0x81, 0xc0, 0xe0, 0x00},
    [ 39] = {0x00, 0x00, 0x76, 0x66, 0x70, 0xe7, 0xfd, 0xc0, 0x1e, 0x00, 0x00, 0x03, 0x81, 0xc0, 0xe0, 0x00},
    [ 40] = {0x00, 0x06, 0x76, 0x66, 0x70, 0xe0, 0xe1, 0xc0, 0x3c, 0xdf, 0xff, 0x83, 0xff, 0xff, 0xe0, 0x00},
    [ 41] = {0x00, 0x07, 0xf6, 0x66, 0x70, 0xe0, 0xe1, 0xc0, 0x7f, 0xdf, 0xff, 0x83, 0xff, 0xff, 0xe0, 0x00},
    [ 42] = {0x00, 0x07, 0x76, 0x66, 0x70, 0xe0, 0xe1, 0xc0, 0x7f, 0xdf, 0xff, 0x83, 0xff, 0xff, 0xe0, 0x00},
    [ 43] = {0x00, 0x07, 0x7e, 0x66, 0x70, 0xe0, 0xe1, 0xe0, 0x7f, 0x1c, 0x03, 0x80, 0x0f, 0xf8, 0x00, 0x00},
    [ 44] = {0x00, 0x0f, 0x0e, 0x86, 0x70, 0xe4, 0xe1, 0xe4, 0x20, 0x1c, 0x03, 0x80, 0x1f, 0xfc, 0x00, 0x00},
    [ 45] = {0x00, 0x0f, 0x1f, 0xc6, 0x70, 0xec, 0xe1, 0xe7, 0x00, 0x1c, 0x03, 0x80, 0x3d, 0xde, 0x00, 0x00},
    [ 46] = {0x00, 0x0f, 0x1f, 0xc6, 0x70, 0xfc, 0xfd, 0xef, 0x01, 0xdc, 0x03, 0x80, 0xf9, 0xcf, 0x80, 0x00},
    [ 47] = {0x00, 0x0e, 0x3d, 0xe0, 0x70, 0xfc, 0xfc, 0xee, 0x1f, 0xdf, 0xff, 0x81, 0xf1, 0xc7, 0xc0, 0x00},
    [ 48] = {0x00, 0x0e, 0x78, 0xf0, 0xf0, 0xff, 0xfc, 0xee, 0xff, 0xdf, 0xff, 0x87, 0xe1, 0xc3, 0xf0, 0x00},
    [ 49] = {0x00, 0x1e, 0xf0, 0x77, 0xf1, 0xff, 0xf8, 0xfe, 0x7e, 0x1f, 0xff, 0x8f, 0xc1, 0xc1, 0xf8, 0x00},
    [ 50] = {0x00, 0x1e, 0x70, 0x47, 0xe1, 0xe7, 0x00, 0x7c, 0x60, 0x1c, 0x03, 0x8f, 0x01, 0xc0, 0x78, 0x00},
    [ 51] = {0x00, 0x04, 0x20, 0x07, 0xc0, 0xc0, 0x00, 0x38, 0x00, 0x1c, 0x03, 0x84, 0x01, 0xc0, 0x30, 0x00},
    [ 63] = {0x00, 0x00, 0x00, 0x00, 0x00, 0x00, 0x01, 0xff, 0xff, 0x80, 0x00, 0x00, 0x00, 0x00, 0x00, 0x00},
    [ 64] = {0x00, 0x00, 0x00, 0x00, 0x00, 0x00, 0x01, 0xff, 0xff, 0x80, 0x00, 0x00, 0x00, 0x00, 0x00, 0x00},
    [ 76] = {0x00, 0x0c, 0x03, 0x80, 0x21, 0xc0, 0x38, 0x00, 0x1c, 0x00, 0x03, 0x03, 0xe0, 0x04, 0x20, 0x00},
    [ 77] = {0x00, 0x1e, 0x03, 0x80, 0xf1, 0xc0, 0x38, 0x06, 0x3e, 0x00, 0xe7, 0x87, 0xe2, 0x0e, 0x78, 0x00},
    [ 78] = {0x00, 0x1f, 0x83, 0x83, 0xf1, 0xff, 0xf8, 0x7e, 0x7f, 0x1f, 0xff, 0x8f, 0xee, 0x0f, 0x78, 0x00},
    [ 79] = {0x00, 0x0f, 0xc3, 0x87, 0xe1, 0xff, 0xfb, 0xff, 0x77, 0x3f, 0xff, 0x0f, 0x0f, 0x1e, 0x70, 0x00},
    [ 80] = {0x00, 0x03, 0xe3, 0x8f, 0x81, 0xff, 0xfb, 0xf8, 0x77, 0x3f, 0x3f, 0x0e, 0x07, 0xbc, 0x70, 0x00},
    [ 81] = {0x00, 0x01, 0xf3, 0x9f, 0x01, 0xc0, 0x3b, 0x80, 0xf7, 0xbf, 0x3f, 0x0e, 0x63, 0xf8, 0xf0, 0x00},
    [ 82] = {0x00, 0x00, 0x7b, 0xbc, 0x01, 0xc0, 0x38, 0x00, 0xe7, 0x87, 0x37, 0x0e, 0x63, 0xf8, 0xf0, 0x00},
    [ 83] = {0x00, 0x00, 0x3f, 0xf8, 0x01, 0xc0, 0x38, 0x04, 0x27, 0x87, 0x27, 0x0e, 0x61, 0x70, 0xf0, 0x00},
    [ 84] = {0x00, 0x00, 0x1f, 0xf0, 0x01, 0xc0, 0x38, 0xfe, 0x07, 0x87, 0x07, 0x0e, 0x66, 0x7e, 0xe0, 0x00},
    [ 85] = {0x00, 0x07, 0xff, 0xff, 0xc1, 0xff, 0xfb, 0xfe, 0x03, 0x87, 0x07, 0x0e, 0x66, 0x6e, 0xe0, 0x00},
    [ 86] = {0x00, 0x07, 0xff, 0xff, 0xc1, 0xff, 0xfb, 0xfe, 0x03, 0x87, 0x07, 0x0e, 0x66, 0x6f, 0xe0, 0x00},
    [ 87] = {0x00, 0x07, 0xff, 0xff, 0xc1, 0xff, 0xfb, 0x3c, 0x03, 0x87, 0x07, 0x0e, 0x66, 0x6e, 0x60, 0x00},
    [ 88] = {0x00, 0x07, 0x03, 0x81, 0xc0, 0x00, 0x00, 0x78, 0x03, 0xbf, 0xe7, 0x0e, 0x66, 0x6e, 0x00, 0x00},
    [ 89] = {0x00, 0x07, 0x03, 0x81, 0xc0, 0x00, 0x00, 0xf0, 0x03, 0xbf, 0xe7, 0x0e, 0x66, 0x6e, 0x40, 0x00},
    [ 90] = {0x00, 0x07, 0x03, 0x81, 0xc3, 0xff, 0xf8, 0xf0, 0x03, 0xff, 0xe7, 0x0e, 0x66, 0x6e, 0xe0, 0x00},
    [ 91] = {0x00, 0x07, 0xff, 0xff, 0xc3, 0xff, 0xf9, 0xfe, 0x03, 0xc0, 0x07, 0xee, 0x66, 0x6f, 0xf0, 0x00},
    [ 92] = {0x00, 0x07, 0xff, 0xff, 0xc3, 0xff, 0xf9, 0xfe, 0x03, 0xc0, 0x07, 0xee, 0x66, 0x6e, 0xf8, 0x00},
    [ 93] = {0x00, 0x07, 0xff, 0xff, 0xc0, 0x0f, 0x03, 0xff, 0x03, 0xc0, 0x07, 0xee, 0x66, 0x6e, 0x78, 0x00},
    [ 94] = {0x00, 0x00, 0x03, 0x80, 0x00, 0x0f, 0x07, 0x8e, 0x7f, 0xff, 0xe0, 0x0e, 0x66, 0x6e, 0x10, 0x00},
    [ 95] = {0x00, 0x00, 0x03, 0x80, 0x00, 0x0f, 0x07, 0x9e, 0x7f, 0xff, 0xe0, 0x0e, 0x66, 0x6e, 0x00, 0x00},
    [ 96] = {0x00, 0x1f, 0xff, 0xff, 0xf7, 0xff, 0xfd, 0x3c, 0x7f, 0xff, 0xe6, 0x0e, 0x66, 0x0e, 0x40, 0x00},
    [ 97] = {0x00, 0x1f, 0xff, 0xff, 0xf7, 0xff, 0xfc, 0x38, 0x33, 0xc0, 0x0f, 0x0e, 0x66, 0x0e, 0xe0, 0x00},
    [ 98] = {0x00, 0x1f, 0xff, 0xff, 0xf7, 0xff, 0xfc, 0x78, 0x7b, 0xc0, 0x07, 0x8e, 0x67, 0xff, 0xe0, 0x00},
    [ 99] = {0x00, 0x00, 0x03, 0x80, 0x00, 0x0f, 0x00, 0xf0, 0x3f, 0xc0, 0x07, 0x8e, 0x67, 0xff, 0xf0, 0x00},
    [100] = {0x00, 0x00, 0x03, 0x80, 0x00, 0x0f, 0x00, 0xf0, 0x1f, 0xc0, 0x03, 0xce, 0x07, 0xfe, 0x78, 0x00},
    [101] = {0x00, 0x00, 0x03, 0x80, 0x00, 0x0f, 0x00, 0x20, 0x1b, 0xc0, 0x01, 0x0e, 0x00, 0x00, 0x20, 0x00},
};
```
